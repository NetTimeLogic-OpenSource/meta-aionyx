## conf/distro/include/aionyx-version.conf
```bitbake
# Main release version
AIONYX_VER_MAIN = "2026.1"

# Set to "release" for major releases and "update-1" for update releases
AIONYX_VER_UPDATE = "snapshot"

# This will be set in local.conf for CI builds
AIONYX_VER_BUILD ?= "${@'${METADATA_REVISION}' if d.getVar('METADATA_REVISION') != '<unknown>' else 'unknown'}"

# Aionyx version
AIONYX_VERSION = "${AIONYX_VER_MAIN}"
```

## conf/layer.conf
```bitbake
# We have a conf and classes directory, add to BBPATH
BBPATH .= ":${LAYERDIR}"

# We need to override a class
# organize the files like oe-core to make them easier to manage
BBPATH =. "${LAYERDIR}/oe-core/meta:"
AIONYX_COREBASE = "${LAYERDIR}/oe-core"

# Keep layer path so recipes can reference it
AIONYX_PATH = "${LAYERDIR}"

# We have a packages directory, add to BBFILES
BBFILES += " \
		${LAYERDIR}/recipes-*/*/*.bb \
		${LAYERDIR}/recipes-*/*/*.bbappend"

BBFILES_DYNAMIC += " \
    provenrun:${LAYERDIR}/dynamic-layers/provenrun/recipes-*/*/*.bb \
    provenrun:${LAYERDIR}/dynamic-layers/provenrun/recipes-*/*/*.bbappend \
    xilinx-tools:${LAYERDIR}/dynamic-layers/xilinx-tools/recipes-*/*/*.bb \
    xilinx-tools:${LAYERDIR}/dynamic-layers/xilinx-tools/recipes-*/*/*.bbappend \
    xilinx:${LAYERDIR}/dynamic-layers/xilinx-core/recipes-*/*/*.bb \
    xilinx:${LAYERDIR}/dynamic-layers/xilinx-core/recipes-*/*/*.bbappend \
    xilinx-standalone-sdt:${LAYERDIR}/dynamic-layers/xilinx-standalone-sdt/recipes-*/*/*.bb \
    xilinx-standalone-sdt:${LAYERDIR}/dynamic-layers/xilinx-standalone-sdt/recipes-*/*/*.bbappend \
    xilinx-mali400:${LAYERDIR}/dynamic-layers/xilinx-mali400/recipes-*/*/*.bb \
    xilinx-mali400:${LAYERDIR}/dynamic-layers/xilinx-mali400/recipes-*/*/*.bbappend \
    "

BBFILE_COLLECTIONS += "aionyx"
BBFILE_PRIORITY_aionyx = "6"
BBFILE_PATTERN_aionyx := "^${LAYERDIR}/"

LAYERDEPENDS_aionyx = "\
    core \
    multimedia-layer \
    xilinx \
    xilinx-standalone \
    "

LAYERRECOMMENDS_aionyx = "xilinx-tools xilinx-standalone-sdt provenrun"

# Sanity check for meta-aionyx layer.
# Setting SKIP_META_AIONYX_SANITY_CHECK to "1" would skip the bbappend files check.
#INHERIT += "aionyx-sanity-meta-aionyx"

SIGGEN_EXCLUDERECIPES_ABISAFE += " \
	gcc-cross-xilinx \
	binutils-cross-xilinx \
	"

SIGGEN_EXCLUDE_SAFE_RECIPE_DEPS += " \
	base-files->base-files-ntl \
	base-files-ntl->base-files-board \
	base-files-ntl->base-files-board-variant \
	base-files-ntl->base-files-board-soc \
	"
BB_DANGLINGAPPENDS_WARNONLY = "true"

LAYERSERIES_COMPAT_aionyx = "scarthgap"
```
